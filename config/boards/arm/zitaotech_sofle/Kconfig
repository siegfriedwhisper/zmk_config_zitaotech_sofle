## config/boards/arm/zitaotech_sofle/Kconfig
```kconfig
# Copyright (c) 2025 ZitaoTech
# SPDX-License-Identifier: MIT

config BOARD_ZITAOTECH_SOFLE_LEFT
    bool

# Numpad variant (standalone, left PCB)
config BOARD_ZITAOTECH_SOFLE_NUMPAD
    bool

# config BOARD_ZITAOTECH_SOFLE_RIGHT
#     bool
```

## config/boards/arm/zitaotech_sofle/Kconfig.defconfig
```kconfig
#
# Copyright (c) 2025 ZitaoTech
# SPDX-License-Identifier: MIT
#

if BOARD_ZITAOTECH_SOFLE_LEFT

config ZMK_KEYBOARD_NAME
    default "ZITAOTECH_SOFLE"

config ZMK_SPLIT_ROLE_CENTRAL
    default y

endif # BOARD_ZITAOTECH_SOFLE_LEFT


if BOARD_ZITAOTECH_SOFLE_LEFT || BOARD_ZITAOTECH_SOFLE_NUMPAD

if ZMK_BACKLIGHT

config PWM
    default y

config LED_PWM
    default y

endif # ZMK_BACKLIGHT

if BOARD_ZITAOTECH_SOFLE_LEFT
config BOARD
    default "ZITAOTECH_SOFLE"

config ZMK_SPLIT
    default y

config ZMK_SPLIT_PERIPHERAL_HID_INDICATORS
    default y
endif

config BT_CTLR
    default BT

endif # BOARD_ZITAOTECH_SOFLE_LEFT || BOARD_ZITAOTECH_SOFLE_NUMPAD


# =====================================================
# Numpad — standalone, no split
# =====================================================
if BOARD_ZITAOTECH_SOFLE_NUMPAD

config ZMK_KEYBOARD_NAME
    default "ZITAOTECH NUMPAD"

config BOARD
    default "ZITAOTECH_SOFLE_NUMPAD"

config ZMK_SPLIT
    default n

endif # BOARD_ZITAOTECH_SOFLE_NUMPAD
```

## config/boards/arm/zitaotech_sofle/zitaotech_sofle_numpad_defconfig
```kconfig
# Copyright (c) 2025 ZitaoTech
# SPDX-License-Identifier: MIT

CONFIG_SOC_SERIES_NRF52X=y
CONFIG_SOC_NRF52840_QIAA=y
CONFIG_BOARD_ZITAOTECH_SOFLE_NUMPAD=y

# Enable MPU
CONFIG_ARM_MPU=y

# enable GPIO
CONFIG_GPIO=y
CONFIG_PINCTRL=y

# Build Configuration
CONFIG_USE_DT_CODE_PARTITION=y
CONFIG_BUILD_OUTPUT_UF2=y

# Flash configuration
CONFIG_MPU_ALLOW_FLASH_WRITE=y
CONFIG_NVS=y
CONFIG_SETTINGS_NVS=y
CONFIG_FLASH=y
CONFIG_FLASH_PAGE_LAYOUT=y
CONFIG_FLASH_MAP=y

CONFIG_ZMK_SLEEP=y
CONFIG_ZMK_IDLE_SLEEP_TIMEOUT=1800000
CONFIG_ZMK_EXT_POWER=y
CONFIG_ZMK_IDLE_TIMEOUT=30000

# Keyboard backlight
CONFIG_ZMK_BACKLIGHT=y
CONFIG_ZMK_BACKLIGHT_BRT_START=40
CONFIG_ZMK_BACKLIGHT_BRT_STEP=10
CONFIG_ZMK_BACKLIGHT_ON_START=y
CONFIG_ZMK_BACKLIGHT_AUTO_OFF_IDLE=y

# RGB backlight
CONFIG_ZMK_RGB_UNDERGLOW=y
CONFIG_ZMK_RGB_UNDERGLOW_EXT_POWER=n
CONFIG_WS2812_STRIP=y

# HID indicators
CONFIG_ZMK_HID_INDICATORS=y

# Debounce
CONFIG_ZMK_KSCAN_DEBOUNCE_PRESS_MS=10
CONFIG_ZMK_KSCAN_DEBOUNCE_RELEASE_MS=10

# Enable both USB and BLE
CONFIG_ZMK_USB=y
CONFIG_ZMK_BLE=y

CONFIG_ZMK_SETTINGS_SAVE_DEBOUNCE=1000

# ZMK Studio
CONFIG_ZMK_STUDIO=y
CONFIG_ZMK_STUDIO_LOCKING=n
CONFIG_ZMK_STUDIO_LOCK_ON_DISCONNECT=n

# Enable EC11
CONFIG_EC11=y
CONFIG_EC11_TRIGGER_GLOBAL_THREAD=y

# BLE device name
CONFIG_BT_DEVICE_NAME_MAX=30
```
